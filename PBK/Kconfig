## PBK/Kconfig
```kconfig
# Purpose-Built Kernel(PBK)

menuconfig PURPOSE_BUILT_KERNEL
    bool "Purpose-Built Kernel"
    default y
    depends on SMP && NUMA && HOTPLUG_CPU
    help
      Purpose-Built Kernel 
      
```

## arch/loongarch/Kconfig.debug
```kconfig
# SPDX-License-Identifier: GPL-2.0

config CMDLINE_BOOL
	bool "Built-in kernel command line"
	default n
	help
	  For most systems, it is firmware or second stage bootloader that
	  by default specifies the kernel command line options.  However,
	  it might be necessary or advantageous to either override the
	  default kernel command line or add a few extra options to it.
	  For such cases, this option allows you to hardcode your own
	  command line options directly into the kernel.  For that, you
	  should choose 'Y' here, and fill in the extra boot arguments
	  in CONFIG_CMDLINE.

	  The built-in options will be concatenated to the default command
	  line if CMDLINE_OVERRIDE is set to 'N'. Otherwise, the default
	  command line will be ignored and replaced by the built-in string.

	  Most LoongArch systems will normally expect 'N' here and rely upon
	  the command line from the firmware or the second-stage bootloader.

config CMDLINE
	string "Default kernel command string"
	depends on CMDLINE_BOOL
	default ""
	help
	  On some platforms, there is currently no way for the boot loader to
	  pass arguments to the kernel.  For these platforms, and for the cases
	  when you want to add some extra options to the command line or ignore
	  the default command line, you can supply some command-line options at
	  build time by entering them here.  In other cases you can specify
	  kernel args so that you don't have to set them up in board prom
	  initialization routines.

	  For more information, see the CMDLINE_BOOL and CMDLINE_OVERRIDE
	  options.

config CMDLINE_OVERRIDE
	bool "Built-in command line overrides firmware arguments"
	default n
	depends on CMDLINE_BOOL
	help
	  By setting this option to 'Y' you will have your kernel ignore
	  command line arguments from firmware or second stage bootloader.
	  Instead, the built-in command line will be used exclusively.

	  Normally, you will choose 'N' here.

choice
	prompt "Choose kernel unwinder"
	default UNWINDER_PROLOGUE if KALLSYMS
	help
	  This determines which method will be used for unwinding kernel stack
	  traces for panics, oopses, bugs, warnings, perf, /proc/<pid>/stack,
	  livepatch, lockdep, and more.

config UNWINDER_GUESS
	bool "Guess unwinder"
	help
	  This option enables the "guess" unwinder for unwinding kernel stack
	  traces.  It scans the stack and reports every kernel text address it
	  finds.  Some of the addresses it reports may be incorrect.

config UNWINDER_PROLOGUE
	bool "Prologue unwinder"
	depends on KALLSYMS
	help
	  This option enables the "prologue" unwinder for unwinding kernel stack
	  traces.  It unwind the stack frame based on prologue code analyze.  Symbol
	  information is needed, at least the address and length of each function.
	  Some of the addresses it reports may be incorrect.

endchoice

config DEBUG_ZBOOT
	bool "Enable compressed kernel support debugging"
	depends on DEBUG_KERNEL && SYS_SUPPORTS_ZBOOT
	default n
	help
	  If you want to add compressed kernel support to a new board, and the
	  board supports uart16550 compatible serial port, please select
	  SYS_SUPPORTS_ZBOOT_UART16550 for your board and enable this option to
	  debug it.

	  If your board doesn't support uart16550 compatible serial port, you
	  can try to select SYS_SUPPORTS_ZBOOT and use the other methods to
	  debug it. for example, add a new serial port support just as
	  arch/loongarch/boot/compressed/uart-16550.c does.

	  After the compressed kernel support works, please disable this option
	  to reduce the kernel image size and speed up the booting procedure a
	  little.
```

## block/Kconfig.iosched
```kconfig
# SPDX-License-Identifier: GPL-2.0
if BLOCK

menu "IO Schedulers"

config MQ_IOSCHED_DEADLINE
	tristate "MQ deadline I/O scheduler"
	default y
	help
	  MQ version of the deadline IO scheduler.

config MQ_IOSCHED_KYBER
	tristate "Kyber I/O scheduler"
	default y
	help
	  The Kyber I/O scheduler is a low-overhead scheduler suitable for
	  multiqueue and other fast devices. Given target latencies for reads and
	  synchronous writes, it will self-tune queue depths to achieve that
	  goal.

config IOSCHED_BFQ
	tristate "BFQ I/O scheduler"
	help
	BFQ I/O scheduler for BLK-MQ. BFQ distributes the bandwidth of
	of the device among all processes according to their weights,
	regardless of the device parameters and with any workload. It
	also guarantees a low latency to interactive and soft
	real-time applications.  Details in
	Documentation/block/bfq-iosched.rst

config BFQ_GROUP_IOSCHED
       bool "BFQ hierarchical scheduling support"
       depends on IOSCHED_BFQ && BLK_CGROUP
       select BLK_CGROUP_RWSTAT
	help

       Enable hierarchical scheduling in BFQ, using the blkio
       (cgroups-v1) or io (cgroups-v2) controller.

config BFQ_CGROUP_DEBUG
	bool "BFQ IO controller debugging"
	depends on BFQ_GROUP_IOSCHED
	help
	Enable some debugging help. Currently it exports additional stat
	files in a cgroup which can be useful for debugging.

config IOSCHED_ROW
	tristate "ROW I/O scheduler"
	default y
	---help---
	  The ROW I/O scheduler gives priority to READ requests over the
	  WRITE requests when dispatching, without starving WRITE requests.
	  Requests are kept in priority queues. Dispatching is done in a RR
	  manner when the dispatch quantum for each queue is calculated
	  according to queue priority.
	  Most suitable for mobile devices.

choice
	prompt "Default I/O scheduler"
	default DEFAULT_CFQ
	help
	  Select the I/O scheduler which will be used by default for all
	  block devices.

	config DEFAULT_DEADLINE
		bool "Deadline" if IOSCHED_DEADLINE=y

	config DEFAULT_ROW
		bool "ROW" if IOSCHED_ROW=y
		help
		  The ROW I/O scheduler gives priority to READ requests
		  over the WRITE requests when dispatching, without starving
		  WRITE requests. Requests are kept in priority queues.
		  Dispatching is done in a RR manner when the dispatch quantum
		  for each queue is defined according to queue priority.
		  Most suitable for mobile devices.

	config DEFAULT_CFQ
		bool "CFQ" if IOSCHED_CFQ=y

	config DEFAULT_NOOP
		bool "No-op"

endchoice

config DEFAULT_IOSCHED
	string
	default "deadline" if DEFAULT_DEADLINE
	default "row" if DEFAULT_ROW
	default "cfq" if DEFAULT_CFQ
	default "noop" if DEFAULT_NOOP

endmenu

endif
```

## drivers/arm/spe/Kconfig
```kconfig
# SPDX-License-Identifier: GPL-2.0-only
#
# arm spe dirver
#
config ARM_SPE
	bool "In-kernel SPE for driver for page access profiling"
	depends on ARM64
	default n
        help
	  Enable support for the ARMv8.2 Statistical Profiling Extension, which
	  provides periodic sampling of operations in the CPU pipeline.
```

## drivers/net/ethernet/yunsilicon/xsc/pci/Kconfig
```kconfig
# SPDX-License-Identifier: GPL-2.0
# Copyright (C) 2021 - 2023, Shanghai Yunsilicon Technology Co., Ltd.
# All rights reserved.
# Yunsilicon PCI configuration
#

config YUNSILICON_XSC_PCI
        tristate "Yunsilicon XSC PCI driver"
        default m
        help
          This driver is common for Yunsilicon XSC
          ethernet and RDMA drivers.
```

## drivers/xpu/Kconfig
```kconfig
# SPDX-License-Identifier: GPL-2.0

menuconfig XPU_SCHEDULE
	bool "xpu schedule"
	default n
	help
	  Support xpu schedule, Say Y here if you want support for use
	  xpu schedule.
```

## kernel/ucc/Kconfig
```kconfig
#
# TODO: add description
#

config XPU_UCC
	bool "ucc"
	default n
	depends on ARM64 || X86
	help
	  Say Y here if you want support for using XPU UCC. XPU UCC
	  is helpfer for XPU schedule. The full name of UCC is
	  Universal Converged Computing.


config XPU_VSTREAM
	bool "virtual submit queue and complete queue"
	default n
	depends on XPU_UCC
	help
	  virtual Submit Queue and Complete Queue support for XPU.
	  It is used to help XPU schedule.
```

## sound/soc/loongson/Kconfig
```kconfig
# SPDX-License-Identifier: GPL-2.0
menu "SoC Audio for Loongson CPUs"
	depends on LOONGARCH || COMPILE_TEST

config SND_SOC_LOONGSON_I2S_PCI
	tristate "Loongson I2S controller as pci device"
	depends on PCI
	help
	  Say Y or M if you want to add support for codecs attached to
	  the I2S interface. You will also need to select the Audio
	  interfaces to support below.

	  The controller is found in loongson bridge chips or SoCs,
	  and works as a PCI device.

config SND_SOC_LOONGSON_CARD
	tristate "Loongson ASoC Sound Card Driver"
	select SND_SOC_LOONGSON_I2S
	help
	  Say Y or M if you want to add support for SoC audio using
	  loongson I2S controller.

	  The driver adds support for ALSA SoC Audio support using
	  loongson I2S controller.

endmenu
```
